/*
 * Copyright (c) 2025 Lucian Copeland for Adafruit Industries
 *
 * SPDX-License-Identifier: Apache-2.0
 */

#include <zephyr/dt-bindings/i2c/i2c.h>

&xiao_i2c {
	status = "okay";
	clock-frequency = <I2C_BITRATE_STANDARD>;

	haptic: drv2605@5a {
		compatible = "ti,drv2605";
		reg = <0x5a>;
		status = "okay";

		actuator-mode = "LRA";
		loop-gain = "HIGH";
		feedback-brake-factor = "2X";
	};
};
