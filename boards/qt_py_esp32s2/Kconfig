## boards/qt_py_esp32s2/Kconfig
```kconfig
# Copyright (c) 2025 Lucian Copeland for Adafruit Industries
# SPDX-License-Identifier: Apache-2.0

config HEAP_MEM_POOL_ADD_SIZE_BOARD
	int
	default 4096
```

## boards/qt_py_esp32s2/Kconfig.qt_py_esp32s2
```kconfig
# Copyright (c) 2025 Lucian Copeland for Adafruit Industries
# SPDX-License-Identifier: Apache-2.0

config BOARD_QT_PY_ESP32S2
	select SOC_ESP32S2_FN4R2
```

## boards/qt_py_esp32s2/board.yml
```yaml
board:
  name: qt_py_esp32s2
  full_name: Adafruit QT Py ESP32-S2
  vendor: adafruit
  socs:
  - name: esp32s2
```

## boards/qt_py_m0/Kconfig.qt_py_m0
```kconfig
# Copyright (c) 2025 Lucian Copeland for Adafruit Industries
# SPDX-License-Identifier: Apache-2.0

config BOARD_QT_PY_M0
	select SOC_SAMD21E18A
```

## boards/qt_py_m0/board.yml
```yaml
board:
  name: qt_py_m0
  full_name: Adafruit QT Py M0
  vendor: adafruit
  socs:
    - name: samd21e18a
```
